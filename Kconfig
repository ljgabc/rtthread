## components/Kconfig
```kconfig
config RT_USING_COMPONENTS_INIT
    bool
    default y

config RT_USING_USER_MAIN
    bool
    default y

    if RT_USING_USER_MAIN
        config RT_MAIN_THREAD_STACK_SIZE
            int "Set main thread stack size"
            default 256

        config RT_MAIN_THREAD_PRIORITY
            int "Set main thread priority"
            default 4   if RT_THREAD_PRIORITY_8
            default 10  if RT_THREAD_PRIORITY_32
            default 85  if RT_THREAD_PRIORITY_256
    endif

menuconfig USING_DEVICE
     bool "Using device system"
     default y

     if USING_DEVICE
          config RT_USING_DEVICE_OPS
              bool "Using ops for device"
              depends on USING_DEVICE
              default y

          orsource "device/Kconfig"
     endif

orsource "ipc/Kconfig"

orsource "button/Kconfig"
```

## components/device/Kconfig
```kconfig
config USING_ADC
     bool "adc api support"
     depends on USING_DEVICE
     default n

config USING_PIN
     bool "pin api support"
     depends on USING_DEVICE
     default y

config USING_SERIAL
     bool "serial api support"
     depends on USING_DEVICE
     select USING_RINGBUFFER
     default n

config SERIAL_RX_FIFOSZ
     int "serial rx fifo size"
     depends on USING_SERIAL
     default 64

config SERIAL_TX_FIFOSZ
     int "serial rx fifo size"
     depends on USING_SERIAL
     default SERIAL_RX_FIFOSZ

config SERIAL_USING_DMA_RX
     bool "serial use dma to rx"
     depends on USING_SERIAL
     default n

config SERIAL_DMA_RX_BUFSZ
     int "serial rx dma buffer size, used to be SERIAL_RX_FIFOSZ / 2"
     depends on SERIAL_USING_DMA_RX
     default 32

config SERIAL_USING_DMA_TX
     bool "serial use dma to tx"
     depends on USING_SERIAL
     default n

config SERIAL_DMA_TX_BUFSZ
     int "serial tx dma buffer size, used to be SERIAL_TX_FIFOSZ / 2"
     depends on SERIAL_USING_DMA_TX
     default SERIAL_DMA_RX_BUFSZ

config USING_TIM
     bool "hwtimer api support"
     depends on USING_DEVICE
     default n

config USING_I2C
     bool "i2c api support"
     depends on USING_DEVICE && RT_USING_MUTEX
     default n
     
config USING_SPI
     bool "spi api support"
     depends on USING_DEVICE
     default n

config USING_WDT
     bool "watchdog api support"
     depends on USING_DEVICE
     default n

config USING_FLASH
     bool "flash api support"
     depends on USING_DEVICE
     default n
     
config USING_CRC
     bool "crc api support"
     depends on USING_DEVICE
     default n
```

## components/ipc/Kconfig
```kconfig
config USING_RINGBUFFER
     bool "ringbuffer support"
     default y

config USING_COMPLETION
     bool "completion support"
     default n

config USING_DATAQUEUE
     bool "dataqueue support"
     depends on RT_USING_HEAP
     default n

config USING_WORKQUEUE
     bool "workqueue support"
     depends on RT_USING_SEMAPHORE
     default n
```

## libcpu/Kconfig
```kconfig
mainmenu "cpu configuration"

config ARCH_ARM
     bool "arch arm"
     
     if ARCH_ARM
     orsource "arm/Kconfig"
     endif

config ARCH_RISCV
     bool "arch risc-v"

     if ARCH_RISCV
     orsource "risc-v/Kconfig"
     endif
```

## libcpu/arm/Kconfig
```kconfig
choice
     prompt "soc"
     default ARM_CM0

config ARM_CM0
     bool "cortex-m0"

config ARM_CM3
     bool "cortex-m3"

config ARM_CM4
     bool "cortex-m4"

config ARM_CM7
     bool "cortex-m7"

config ARM_CM23
     bool "cortex-m23"

config ARM_CM33
     bool "cortex-m33"

endchoice
```

## libcpu/risc-v/Kconfig
```kconfig
choice
     prompt "risc-v soc"
     depends on ARCH_RISCV
     default RV32M1

config RV32M1
     bool "rv32m1"

config K210
     bool "k210"

config E310
     bool "e310"

endchoice
```

## os/Kconfig
```kconfig
config USE_RTOS
    bool "Use RT-Thread RTOS"
    default y

config OS_TICK_RATE
    int "OS tick per second"
    depends on USE_RTOS
    default 100

config OS_MAX_PRIORITY
    int "Maximal level of thread priority <8 - 256>"
    depends on USE_RTOS
    default 8

config OS_USE_TIMER
    bool "Enables soft timers"
    depends on USE_RTOS
    default n

config OS_TIMER_TASK_PRIORITY
    int "The priority level of timer thread <0 - OS_MAX_PRIORITY>"
    depends on OS_USE_TIMER
    default OS_MAX_PRIORITY

config OS_TIMER_TASK_STACK_SIZE
    int "The stack size of timer thread <0-8192>"
    depends on OS_USE_TIMER
    default 256

config OS_USE_SEMAPHORE
    bool "Using Semaphore"
    depends on USE_RTOS
    default n

config OS_USE_MUTEX
    bool "Using Mutex"
    depends on USE_RTOS
    default n

config OS_USE_MESSAGEQUEUE
    bool "Using Message Queue"
    depends on USE_RTOS
    default n

config USE_COMPONENTS_INIT
    bool "Using RT-Thread components initialization"
    depends on USE_RTOS
    default y

config USE_MEMORY_MANAGEMENT
    bool "Dynamic Heap Management"
    depends on USE_RTOS
    select OS_USE_SEMAPHORE
    default y

config HEAP_SIZE
    int "Dynamic Heap Size(Words, 4Bytes), max value = (RAM size - ZI size)"
    depends on USE_MEMORY_MANAGEMENT
    default 1024
    
```
